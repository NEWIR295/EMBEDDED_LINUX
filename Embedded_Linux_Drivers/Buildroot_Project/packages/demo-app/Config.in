## Embedded_Linux_Drivers/Buildroot_Project/packages/demo-app/Config.in
```kconfig
config BR2_PACKAGE_DEMO_APP
    bool "Demo Application"
    help
      Application to control LED with switch.
```

## Embedded_Linux_Drivers/Buildroot_Project/packages/edges-drivers/Config.in
```kconfig
config BR2_PACKAGE_EDGES_DRIVERS
    bool "Edges Custom Drivers"
    help
      Custom LED and Switch drivers for the Edges project.
```
